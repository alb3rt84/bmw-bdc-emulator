/**
 * @file lin_master.cpp
 * @brief LIN Master: break + header scheduler at 19200 baud.
 *
 * Classic LIN break is generated by temporarily dropping the baud rate
 * (or bit-banging a dominant pulse). This template uses a long 0x00 write
 * at a reduced baud to approximate a 13-bit break, then restores 19200
 * and sends sync (0x55) + PID.
 */

#include "lin_master.h"
#include "config.h"

#include <string.h>

namespace lin {

namespace {

HardwareSerial* g_lin = nullptr;

// Default schedule — placeholder PIDs for climate / panel slaves.
// EDIT: replace with your G-chassis LIN schedule (PID + publish/subscribe).
ScheduleEntry g_schedule[16] = {
    // Example: master requests status from slave ID 0x10 every 50 ms
    {0x10, 0, {0}, false, 50, 0},
    // Example: master publishes 4 bytes to ID 0x20 every 100 ms
    {0x20, 4, {0x00, 0x00, 0x00, 0x00}, true, 100, 0},
};
size_t g_scheduleCount = 2;

/** Classic LIN PID parity (ID bits 0..5 → P0/P1 in bits 6/7). */
uint8_t protectId(uint8_t id) {
  id &= 0x3F;
  const uint8_t p0 = ((id >> 0) ^ (id >> 1) ^ (id >> 2) ^ (id >> 4)) & 0x01;
  const uint8_t p1 = (~((id >> 1) ^ (id >> 3) ^ (id >> 4) ^ (id >> 5))) & 0x01;
  return (uint8_t)(id | (p0 << 6) | (p1 << 7));
}

uint8_t classicChecksum(uint8_t pid, const uint8_t* data, uint8_t len, bool enhanced) {
  uint16_t sum = enhanced ? pid : 0;
  for (uint8_t i = 0; i < len; i++) {
    sum += data[i];
    if (sum >= 256) sum = (sum & 0xFF) + 1;
  }
  return (uint8_t)(~sum);
}

void sendBreakAndHeader(uint8_t id) {
  if (!g_lin) return;

  // Approximate 13-bit dominant break: send 0x00 at ~9600 so the low pulse
  // is long enough for slaves at 19200 to detect a break.
  g_lin->updateBaudRate(9600);
  g_lin->write((uint8_t)0x00);
  g_lin->flush();

  g_lin->updateBaudRate(LIN_BAUD);
  g_lin->write((uint8_t)0x55);           // sync
  g_lin->write(protectId(id));           // protected ID
  g_lin->flush();
}

void sendMasterFrame(const ScheduleEntry& e) {
  sendBreakAndHeader(e.pid);
  if (!e.masterOwnsData || e.dlc == 0) {
    // Header-only: slave is expected to respond (not parsed in this template)
    return;
  }
  for (uint8_t i = 0; i < e.dlc; i++) {
    g_lin->write(e.data[i]);
  }
  // Enhanced checksum (LIN 2.x) — switch to classic if talking to LIN 1.3 slaves
  g_lin->write(classicChecksum(protectId(e.pid), e.data, e.dlc, /*enhanced=*/true));
  g_lin->flush();
}

}  // namespace

bool init() {
  pinMode(PIN_LIN_NSLP, OUTPUT);
  digitalWrite(PIN_LIN_NSLP, HIGH);  // TJA1020 normal / slope mode

  g_lin = &Serial2;
  g_lin->begin(LIN_BAUD, SERIAL_8N1, PIN_LIN_RX, PIN_LIN_TX);
  Serial.printf("[LIN] Master UART%u @ %d baud (TX=%d RX=%d NSLP=%d)\n",
                LIN_UART_NUM, LIN_BAUD, PIN_LIN_TX, PIN_LIN_RX, PIN_LIN_NSLP);
  return true;
}

void setSchedule(const ScheduleEntry* entries, size_t count) {
  if (!entries || count == 0) return;
  if (count > (sizeof(g_schedule) / sizeof(g_schedule[0]))) {
    count = sizeof(g_schedule) / sizeof(g_schedule[0]);
  }
  memcpy(g_schedule, entries, count * sizeof(ScheduleEntry));
  g_scheduleCount = count;
}

void masterTask(void* /*arg*/) {
  Serial.println(F("[LIN] Scheduler task started"));
  for (;;) {
    const uint32_t now = millis();
    for (size_t i = 0; i < g_scheduleCount; i++) {
      ScheduleEntry& e = g_schedule[i];
      if ((now - e.lastSentMs) < e.periodMs) continue;
      sendMasterFrame(e);
      e.lastSentMs = now;
    }
    vTaskDelay(pdMS_TO_TICKS(5));
  }
}

}  // namespace lin
